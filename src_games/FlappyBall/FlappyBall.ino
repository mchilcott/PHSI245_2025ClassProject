/*
  FlappyBall — ported to PHSI245 OS
  Original: Chris Martinez (2014), Scott Allen (2016)
  Port:    PHSI245 OS native (no Arduboy2 dependency)
*/

#include <Arduino.h>
#include <HAL.h>
#include "gfx.h"
#include "input.h"
#include "ostime.h"
#include "beep.h"
#include "random.h"

// --- Bitmap data (unchanged from original) ---
#ifndef BITMAPS_H
#define BITMAPS_H
const unsigned char floatyball[] PROGMEM = {
0x0,0x0,0x0,0x0,0x0,0x0,0x0,0x0,0x0,0x0,0x0,0x0,0x0,0x0,0x0,0x0,
0x0,0x0,0x0,0x0,0x0,0x0,0x0,0x0,0x0,0x0,0x0,0x0,0x0,0x0,0x0,0x0,
0x1,0x80,0x0,0x1,0xff,0xff,0xff,0xff,0xff,0xff,0xff,0xff,0x80,0x0,
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0x0,0x0,0x0,0x0,0x0,0x0,0x0,0x0,0x0,0x0,0x0,0x0,0x0
};
const unsigned char gameover[] PROGMEM = {
0xff,0x80,0x0,0x3f,0xc3,0xfc,0x7,0xf8,0x0,0x80,0xff,0xff,0xe0,
0x42,0x7,0xfc,0xf,0xf0,0x80,0x83,0x0,0x20,0x42,0x4,0x4c,0x8,0x10,
0x80,0x83,0x0,0x24,0x42,0x4,0x4c,0x88,0x10,0x8f,0xf3,0x0,0x24,
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0x0,0x0,0x0,0x0,0x0
};
#endif

// --- Melodies (converted from ArduboyTones to freq+duration pairs) ---
// Format: {freq_hi, freq_lo, dur_hi, dur_lo, ..., 0,0,0,0}

static const PROGMEM uint8_t melody_hit[] = {
    0x01,0x05, 0x00,0x1F,  // C4=261Hz, 31ms
    0x01,0x15, 0x00,0x1F,  // C#4=277Hz, 31ms
    0x01,0x25, 0x00,0x1F,  // D4=294Hz, 31ms
    0x00,0x00, 0x00,0x00,
};

static const PROGMEM uint8_t melody_point[] = {
    0x03,0xE8, 0x00,0x4B,  // B5=988Hz, 75ms
    0x05,0x28, 0x00,0xE1,  // E6=1319Hz, 225ms
    0x00,0x00, 0x00,0x00,
};

static const PROGMEM uint8_t melody_bing[] = {
    0x00,0x2E, 0x00,0x6B,  // F#1=46Hz, 107ms
    0x01,0x05, 0x01,0xF4,  // C4=261Hz, 500ms
    0x00,0x00, 0x00,0x00,
};

// --- Game constants ---
#define FRAMES_PER_SECOND 30
#define FRAC_BITS 6
#define BALL_ACCELERATION 16
#define BALL_JUMP_VELOCITY (-144)
#define NEG_OFFSET 64
#define PIPE_ARRAY_SIZE 4
#define PIPE_MOVE_DISTANCE 2
#define PIPE_GAP_MAX 30
#define PIPE_GAP_MIN 18
#define PIPE_GAP_REDUCE 5
#define PIPE_WIDTH 12
#define PIPE_CAP_WIDTH 2
#define PIPE_CAP_HEIGHT 3
#define PIPE_MIN_HEIGHT 6
#define PIPE_GEN_FRAMES 32
#define BALL_RADIUS 4
#define BALL_Y_START ((GFX_HEIGHT / 2) - 1)
#define BALL_X 32

// --- Game state ---
static byte  gameState = 0;
static uint16_t gameScore = 0;
static uint16_t gameHighScore = 0;
static char  pipes[2][PIPE_ARRAY_SIZE];
static byte  pipeGap = PIPE_GAP_MAX;
static byte  pipeReduceCount = PIPE_GAP_REDUCE;
static char  ballY = BALL_Y_START, ballYprev = BALL_Y_START, ballYi = BALL_Y_START;
static int   ballV = 0;
static byte  ballFrame = 0;
static char  ballFlapper = BALL_RADIUS;
static char  gameScoreX = 0, gameScoreY = 0;
static byte  gameScoreRiser = 0;
static bool  audioOn = true;
static uint32_t frameCount = 0;

// --- Helpers ---

static byte getOffset(unsigned int s) {
    if (s > 9999) return 24;
    if (s > 999)  return 18;
    if (s > 99)   return 12;
    if (s > 9)    return 6;
    return 0;
}

static bool jumpPressed() {
    const uint8_t btns[] = {PIN_BTN_UP, PIN_BTN_DOWN, PIN_BTN_A, PIN_BTN_B};
    return input::anyPressed(4, btns);
}

static void debounceButtons() {
    ostime::delay_ms(1);
    while (jumpPressed()) { input::update(); }
    ostime::delay_ms(1);
}

static void beginJump() {
    ballV = BALL_JUMP_VELOCITY;
    ballFrame = 0;
    ballYi = ballY;
}

static void startFalling() {
    ballFrame = 0;
    ballYi = ballY;
    ballV = 0;
}

static void moveFloaty() {
    ballYprev = ballY;
    ballFrame++;
    ballV += (BALL_ACCELERATION / 2);
    ballY = ((((ballV * ballFrame)
           + (NEG_OFFSET << FRAC_BITS)
           + (1 << (FRAC_BITS - 1)))
            >> FRAC_BITS)
             - NEG_OFFSET)
              + ballYi;
}

static void drawFloor() {
    gfx::drawFastHLine(0, GFX_HEIGHT-1, GFX_WIDTH, GFX_WHITE);
}

static void drawFloaty() {
    ballFlapper--;
    if (ballFlapper > BALL_RADIUS) ballFlapper = BALL_RADIUS;
    gfx::drawCircle(BALL_X, ballY, BALL_RADIUS, GFX_BLACK);
    gfx::drawCircle(BALL_X, ballY, BALL_RADIUS, GFX_WHITE);
    gfx::drawLine(BALL_X, ballY, BALL_X - (BALL_RADIUS+1), ballY - ballFlapper, GFX_WHITE);
    gfx::drawPixel(BALL_X - (BALL_RADIUS+1), ballY - ballFlapper + 1, GFX_WHITE);
    gfx::drawPixel(BALL_X + 1, ballY - 2, GFX_WHITE);
}

static void drawPipes() {
    for (byte x = 0; x < PIPE_ARRAY_SIZE; x++){
        if (pipes[0][x] != 0) {
            gfx::drawRect(pipes[0][x], -1, PIPE_WIDTH, pipes[1][x], GFX_WHITE);
            gfx::drawRect(pipes[0][x], pipes[1][x] + pipeGap, PIPE_WIDTH,
                          GFX_HEIGHT - pipes[1][x] - pipeGap, GFX_WHITE);
            gfx::drawRect(pipes[0][x] - PIPE_CAP_WIDTH, pipes[1][x] - PIPE_CAP_HEIGHT,
                          PIPE_WIDTH + (PIPE_CAP_WIDTH*2), PIPE_CAP_HEIGHT, GFX_WHITE);
            gfx::drawRect(pipes[0][x] - PIPE_CAP_WIDTH, pipes[1][x] + pipeGap,
                          PIPE_WIDTH + (PIPE_CAP_WIDTH*2), PIPE_CAP_HEIGHT, GFX_WHITE);
            gfx::drawLine(pipes[0][x]+2, 0, pipes[0][x]+2, pipes[1][x]-5, GFX_WHITE);
            gfx::drawLine(pipes[0][x]+2, pipes[1][x] + pipeGap + 5,
                          pipes[0][x]+2, GFX_HEIGHT - 3, GFX_WHITE);
        }
    }
}

static void generatePipe() {
    for (byte x = 0; x < PIPE_ARRAY_SIZE; x++) {
        if (pipes[0][x] == 0) {
            pipes[0][x] = GFX_WIDTH;
            pipes[1][x] = rng::next(PIPE_MIN_HEIGHT, GFX_HEIGHT - PIPE_MIN_HEIGHT - pipeGap);
            return;
        }
    }
}

static bool checkPipe(byte x) {
    byte AxA = BALL_X - (BALL_RADIUS-1);
    byte AxB = BALL_X + (BALL_RADIUS-1);
    byte AyA = ballY - (BALL_RADIUS-1);
    byte AyB = ballY + (BALL_RADIUS-1);
    byte BxA, BxB, ByA, ByB;

    BxA = pipes[0][x]; BxB = pipes[0][x] + PIPE_WIDTH;
    ByA = 0; ByB = pipes[1][x];
    if (AxA < BxB && AxB > BxA && AyA < ByB && AyB > ByA) return true;
    BxA = pipes[0][x] - PIPE_CAP_WIDTH;
    BxB = BxA + PIPE_WIDTH + (PIPE_CAP_WIDTH*2);
    ByA = pipes[1][x] - PIPE_CAP_HEIGHT;
    if (AxA < BxB && AxB > BxA && AyA < ByB && AyB > ByA) return true;
    BxA = pipes[0][x]; BxB = pipes[0][x] + PIPE_WIDTH;
    ByA = pipes[1][x] + pipeGap; ByB = GFX_HEIGHT-1;
    if (AxA < BxB && AxB > BxA && AyA < ByB && AyB > ByA) return true;
    BxA = pipes[0][x] - PIPE_CAP_WIDTH;
    BxB = BxA + PIPE_WIDTH + (PIPE_CAP_WIDTH*2);
    ByB = ByA + PIPE_CAP_HEIGHT;
    if (AxA < BxB && AxB > BxA && AyA < ByB && AyB > ByA) return true;
    return false;
}

static void drawInfo() {
    gfx::setCursor(6, 3);
    gfx::print("A,B,Up,Down: Jump");
    gfx::setCursor(6, 51);
    gfx::print("Left: Sound On/Off");

    byte ulS = audioOn ? 13*6 : 16*6;
    byte ulL = audioOn ? 11 : 17;
    gfx::drawFastHLine(ulS, 59, ulL, GFX_WHITE);
    gfx::drawFastHLine(ulS, 60, ulL, GFX_WHITE);
}

// --- Entry points ---

void setup() {
    gfx::init();
    gfx::setTextSize(1);
    gfx::setTextColor(GFX_WHITE);
    input::init();
    ostime::init();
    beep::init();
    rng::init();
    ostime::setFrameRate(FRAMES_PER_SECOND);

    // Show title screen
    gfx::drawBitmap(0, 0, floatyball, 128, 64, GFX_WHITE);
    gfx::display();
    beep::tone(523, 500);  // C5
    beep::tone(261, 500);  // C4
    ostime::delay_ms(500);
    gfx::clear();
    gfx::setCursor(18, 55);
    gfx::print("Press Any Button");
    gfx::display();

    while (!jumpPressed()) { input::update(); }
    debounceButtons();

    for (byte x = 0; x < PIPE_ARRAY_SIZE; x++) pipes[0][x] = 0;
}

void loop() {
    if (!ostime::nextFrame()) return;
    input::update();
    frameCount++;

    // Sound toggle
    if (input::justPressed(PIN_BTN_LEFT)) {
        audioOn = !audioOn;
        if (audioOn) beep::playMelody(melody_bing);
        debounceButtons();
    }

    gfx::clear();

    // --- State: Wait to begin ---
    if (gameState == 0) {
        drawFloor();
        drawFloaty();
        drawInfo();
        if (jumpPressed()) {
            gameState = 1;
            beginJump();
        }
    }

    // --- State: Playing ---
    if (gameState == 1) {
        if ((ballYprev <= ballY) && jumpPressed()) beginJump();
        moveFloaty();
        if (ballY < BALL_RADIUS) { ballY = BALL_RADIUS; startFalling(); }

        if ((frameCount % PIPE_GEN_FRAMES) == 0) generatePipe();

        for (byte x = 0; x < PIPE_ARRAY_SIZE; x++) {
            if (pipes[0][x] != 0) {
                pipes[0][x] -= PIPE_MOVE_DISTANCE;
                if (pipes[0][x] + PIPE_WIDTH < 0) pipes[0][x] = 0;
                if (pipes[0][x] + PIPE_WIDTH == BALL_X - BALL_RADIUS) {
                    gameScore++;
                    pipeReduceCount--;
                    gameScoreX = BALL_X;
                    gameScoreY = ballY - BALL_RADIUS - 8;
                    gameScoreRiser = 15;
                    if (audioOn) beep::playMelody(melody_point);
                }
            }
        }

        if (gameScoreRiser > 0) {
            gameScoreY--;
            if (gameScoreY >= 0) {
                gfx::setCursor(gameScoreX, gameScoreY);
                gfx::print((int16_t)gameScore);
                gameScoreX -= 2;
                gameScoreRiser--;
            } else gameScoreRiser = 0;
        }

        if (ballY + BALL_RADIUS > GFX_HEIGHT-1) {
            ballY = GFX_HEIGHT-1 - BALL_RADIUS;
            gameState = 2;
        }

        for (byte x = 0; x < PIPE_ARRAY_SIZE; x++)
            if (pipes[0][x] != 0 && checkPipe(x)) gameState = 2;

        drawPipes();
        drawFloor();
        drawFloaty();

        if (pipeGap > PIPE_GAP_MIN && pipeReduceCount <= 0) {
            pipeGap--;
            pipeReduceCount = PIPE_GAP_REDUCE;
        }
    }

    // --- State: Game Over ---
    if (gameState == 2) {
        if (gameScore > gameHighScore) gameHighScore = gameScore;
        gfx::display();
        if (audioOn) beep::playMelody(melody_hit);
        ostime::delay_ms(100);

        startFalling();
        while (ballY + BALL_RADIUS < GFX_HEIGHT-1) {
            if (!ostime::nextFrame()) continue;
            moveFloaty();
            gfx::clear();
            drawPipes();
            drawFloor();
            drawFloaty();
            gfx::display();
        }

        beep::tone(261, 300);
        ostime::delay_ms(100);
        gfx::drawRect(16, 8, 96, 48, GFX_WHITE);
        gfx::fillRect(17, 9, 94, 46, GFX_BLACK);
        gfx::drawBitmap(30, 12, gameover, 72, 14, GFX_WHITE);

        gfx::setCursor(50 - getOffset(gameScore), 30);
        gfx::print((int16_t)gameScore);
        gfx::setCursor(62, 30);
        gfx::print("Score");
        gfx::setCursor(50 - getOffset(gameHighScore), 42);
        gfx::print((int16_t)gameHighScore);
        gfx::setCursor(62, 42);
        gfx::print("High");
        gfx::display();

        ostime::delay_ms(1000);
        while (!jumpPressed()) { input::update(); }
        debounceButtons();

        gameState = 0;
        beep::tone(523, 150);
        gameScore = 0;
        gameScoreRiser = 0;
        for (byte x = 0; x < PIPE_ARRAY_SIZE; x++) pipes[0][x] = 0;
        ballY = BALL_Y_START;
        pipeGap = PIPE_GAP_MAX;
        pipeReduceCount = PIPE_GAP_REDUCE;
    }

    gfx::display();
}
